// SPDX-License-Identifier: GPL-2.0-only
/*
 * Ripcurrent board device tree source
 *
 * Copyright 2022 Google LLC
 */

/dts-v1/;
/plugin/;

#include <dt-bindings/interrupt-controller/arm-gic.h>
#include <dt-bindings/pinctrl/gs101.h>
#include <dt-bindings/pinctrl/samsung.h>

#include "../google-dts-base/zuma-common.dtsi"

#include "zuma-ripcurrent-usb.dtsi"
#include "zuma-ripcurrent-camera-pmic.dtsi"
#include "zuma-ripcurrent-camera.dtsi"
#include "zuma-ripcurrent-display.dtsi"
#include "zuma-ripcurrent-battery.dtsi"
#include "zuma-ripcurrent-charging.dtsi"
#include "zuma-ripcurrent-gsa-gsc.dtsi"
#include "zuma-ripcurrent-touch.dtsi"
#include "zuma-ripcurrent-usecases.dtsi"
#include "zuma-ripcurrent-wcharger.dtsi"
#include "zuma-board-wlan.dtsi"
#include "zuma-board-cp-s5300-sit.dtsi"
#include "zuma-board-bluetooth.dtsi"
#include "zuma-ripcurrent-audio.dtsi"
#include "zuma-ripcurrent-gps.dtsi"
#include "zuma-ripcurrent-nfc.dtsi"
#include "zuma-ripcurrent-ese.dtsi"
#include "zuma-board-pcie.dtsi"

/ {
	board_id = <0x40101>;
	board_rev = <0x000000>;
	fragment@boardbase {
		target-path = "/";
		__overlay__ {
			model = "ZUMA Ripcurrent board based on ZUMA";
			compatible = "google,ZUMA Ripcurrent", "google,ZUMA";
		};
	};
};

