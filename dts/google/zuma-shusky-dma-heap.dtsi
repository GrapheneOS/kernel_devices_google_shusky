// SPDX-License-Identifier: GPL-2.0-only
/*
 * DMA heap device tree entries specific to husky and shiba.
 *
 * Copyright 2023 Google,LLC
 *
 */

&faceauth_tpu_dma_heap {
	compatible = "google,dma-heap-gcma";
};

&faceauth_tpu {
	size = <0x00A00000>; /* 10MB */
};

&farawimg {
	size = <0x0CE00000>; /* 206MB */
};