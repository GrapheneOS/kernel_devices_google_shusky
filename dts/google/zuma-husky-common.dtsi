// SPDX-License-Identifier: GPL-2.0-only
/*
 * Husky board device tree source
 *
 * Copyright 2022 Google LLC
 */

#include "zuma-board.dtsi"

#include "zuma-husky-audio.dtsi"
#include "zuma-husky-camera.dtsi"
#include "zuma-husky-display.dtsi"
#include "zuma-husky-touch.dtsi"
#include "zuma-shusky-haptics.dtsi"
#include "zuma-ripcurrent-uwb.dtsi"
