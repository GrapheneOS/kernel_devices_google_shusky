// SPDX-License-Identifier: GPL-2.0-only
/*
 * Battery device tree entries specific to panther
 *
 * Copyright 2022 Google,LLC
 *
 */

&pca9468_dc {
	pca9468,input-current-limit = <2700000>; /* 5.4A max */
};

&google_charger {
   google,thermal-stats-lvl-map = <0 3 5 8>;
};

&google_cpm {
	google,wlc-dc-fcc-ua = <4037000>; /* 0.9C(4485mah) */

	// thermal budgets
	google,mdis-thermal-mitigation =
	<5204000 3413000 2603000 2017000 1919000 1506000  909000  575000  254000>;
	// source ONLINE selection criteria
	google,mdis-out-sel-online = <1 2>;
	// PD+main-charger, WLC+main-charger
	google,mdis-out0-limits =
	<4000000 3500000 3000000 3000000 2500000 2000000 1500000 1000000   500000
	 1100000  500000  500000  500000  250000  250000  100000  100000   100000>;
	// PPS_CP+pca94xx-mains, // WLC_CP+pca94xx-mains
	google,mdis-out1-limits =
	<5500000  5000000 4500000 4000000 3500000 3000000 2500000 2000000 1000000
	 4500000  3500000 3000000 3000000 2500000 2000000 1500000 1000000       0>;
};

/* TODO: thermal hal */
