// SPDX-License-Identifier: GPL-2.0-only
/*
 * Wireless Charger device tree entries.
 *
 * Copyright 2022 Google LLC
 */

&hsi2c_9 {
	p9412@3c {
		fod = [B7 26 89 3D 89 26 A4 E6 97 F9 9B EA 00 00 00 46];
		fod_epp = [AC 51 86 6A 90 25 88 3A 88 38 8B 22 00 00 00 46];
		fod_hpp = [AF FF 88 2A 83 0D 86 F1 88 E2 89 C9 00 00 01 48];
		fod_hpp_hv = [AF 27 88 4A 83 3F 86 27 88 08 89 E3 00 00 01 48];
		google,q_value = <52>;

		google,alignment_scalar_low_current = <470>;
		google,alignment_scalar_high_current = <100>;
		google,alignment_offset_low_current = <128000>;
		google,alignment_offset_high_current = <148000>;
		google,alignment_current_threshold = <500>;
	};
};
