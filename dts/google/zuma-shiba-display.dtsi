// SPDX-License-Identifier: GPL-2.0-only
/*
 * Display nodes for shiba-related boards.
 *
 * Copyright 2022 Google LLC
 *
 */

#include "zuma-shusky-display.dtsi"

&drmdsim0 {
	google_bigsurf: panel@0 {
		compatible = "google,bigsurf";
		label = "google-bigsurf";
	};
};

&drmdsim1 {
	status = "disabled";
};
