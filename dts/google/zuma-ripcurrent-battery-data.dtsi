// SPDX-License-Identifier: GPL-2.0-only
/*
 * Battery device tree entries
 *
 * Copyright 2022 Google LLC
 *
 */

maxim,config {

	/* ATL: 1_ATL_2937_2_011421_3.3V_RC2_V03.txt, 2021-11-18, b/205853069 */
	/* simulate 1.2C charge: 4087 x 1.2 ~ 4905 (R4) */
	maxim,cos-a1-1k {
		maxim,batt-id-kohm = <1>;
		maxim,model-version = <6>;
		maxim,force-reset-model-data;
		maxim,fg-model = /bits/ 16 <
			0xa4c0 0xaa10 0xb710 0xb9a0 0xbba0 0xbc30 0xbd20 0xbeb0
			0xc030 0xc2e0 0xc560 0xc980 0xcbf0 0xcf10 0xd600 0xdc00
			0x02f0 0x0140 0x0a50 0x0df0 0x13a0 0x0d80 0x1af0 0x1300
			0x0d10 0x07a0 0x0810 0x07c0 0x0780 0x0690 0x0730 0x0730
			0x0200 0x0200 0x0200 0x0200 0x0200 0x0200 0x0200 0x0200
			0x0200 0x0200 0x0200 0x0200 0x0200 0x0200 0x0200 0x0200
		>;
		maxim,fg-params = /bits/ 16 <
			/* 0x0036 */	0xf060	/* IAvgEmpty */
			/* 0x002a */	0x0839	/* RelaxCFG */
			/* 0x0028 */	0x260e	/* LearnCFG */
			/* 0x001D */	0x4217	/* Config */
			/* 0x00BB */	0x0090	/* Config2 */
			/* 0x0013 */	0x5f00	/* FullSOCthr */
			/* 0x0035 */	0x07fb	/* FullCAPRep */
			/* 0x0018 */	0x07fb	/* DesignCap */
			/* 0x0046 */	0x3200	/* dPacc */
			/* 0x0045 */	0x0275	/* dQacc */
			/* 0x0023 */	0x07fb	/* FullCAPNom */
			/* 0x003A */	0xa561	/* V_empty */
			/* 0x0012 */	0x3100	/* QResidual00 */
			/* 0x0022 */	0x1580	/* QResidual10 */
			/* 0x0032 */	0x0800	/* QResidual20 */
			/* 0x0042 */	0x0780	/* QResidual30 */
			/* 0x0038 */	0x0860	/* RCOMP0 */
			/* 0x0039 */	0x0d02	/* TempCo */
			/* 0x001E */	0x0620	/* ICHGTerm */
			/* 0x002C */	0xED51	/* TGain */
			/* 0x002D */	0x1EBA	/* TOff */
			/* 0x00B9 */	0x0014	/* Curve */
			/* 0x002B */	0x3870	/* MiscCFG */
			/* 0x0004 */	0x1900	/* AtRate */
			/* 0x0049 */	0x2241	/* convgcfg */
			/* 0x0029 */	0xc623	/* FilterCFG */
			/* 0x003c */	0x2D00	/* TaskPeriod */
		>;
	};

	/* Placeholder for 1.5C battery model, b/255239258#comment1 */
	maxim,cos-a1-10k {
		maxim,batt-id-kohm = <10>;
		maxim,model-version = <1>;
		maxim,force-reset-model-data;
		maxim,fg-model = /bits/ 16 <
			0xa500 0xb790 0xb920 0xba60 0xbc70 0xbe00 0xbea0 0xc0b0
			0xc1b0 0xc5d0 0xc930 0xcc40 0xcf40 0xd340 0xd6b0 0xde40
			0x01e0 0x0b00 0x0d00 0x1310 0x1710 0x1410 0x0f00 0x1970
			0x05f0 0x0810 0x07b0 0x07e0 0x05b0 0x07f0 0x04f0 0x04f0
			0x0200 0x0200 0x0200 0x0200 0x0200 0x0200 0x0200 0x0200
			0x0200 0x0200 0x0200 0x0200 0x0200 0x0200 0x0200 0x0200
		>;
		maxim,fg-params = /bits/ 16 <
			/* 0x0036 */	0xf060	/* IAvgEmpty */
			/* 0x002a */	0x0839	/* RelaxCFG */
			/* 0x0028 */	0x260e	/* LearnCFG */
			/* 0x001D */	0x4217	/* Config */
			/* 0x00BB */	0x0090	/* Config2 */
			/* 0x0013 */	0x5f00	/* FullSOCthr */
			/* 0x0035 */	0x09cf	/* FullCAPRep */
			/* 0x0018 */	0x09cf	/* DesignCap */
			/* 0x0046 */	0x3200	/* dPacc */
			/* 0x0045 */	0x0273	/* dQacc */
			/* 0x0023 */	0x09cf	/* FullCAPNom */
			/* 0x003A */	0xa561	/* V_empty */
			/* 0x0012 */	0x2400	/* QResidual00 */
			/* 0x0022 */	0x0f80	/* QResidual10 */
			/* 0x0032 */	0x0580	/* QResidual20 */
			/* 0x0042 */	0x0480	/* QResidual30 */
			/* 0x0038 */	0x0500	/* RCOMP0 */
			/* 0x0039 */	0x1402	/* TempCo */
			/* 0x001E */	0x0630	/* ICHGTerm */
			/* 0x002C */	0xED51	/* TGain */
			/* 0x002D */	0x1EBA	/* TOff */
			/* 0x00B9 */	0x0014	/* Curve */
			/* 0x002B */	0x6030	/* MiscCFG */
			/* 0x0004 */	0x1900	/* AtRate */
			/* 0x0049 */	0x2241	/* convgcfg */
			/* 0x0029 */	0x0613	/* FilterCFG */
			/* 0x003c */	0x2D00	/* TaskPeriod */
		>;
	};
};
