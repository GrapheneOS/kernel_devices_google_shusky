// SPDX-License-Identifier: GPL-2.0-only
/*
 * Display nodes for slider-related boards.
 *
 * Copyright 2022 Google LLC
 *
 */

#include "zuma-shusky-display.dtsi"

&drmdsim0 {
	panel@0 {
		touch = <&spitouch>;
	};
};

&drmdsim1 {
	panel@2 {
		compatible = "google,hk3";
		label = "google-hk3";
		channel = <0>;

		/* reset, power */
		reset-gpios = <&gpp10 0 GPIO_ACTIVE_HIGH>;
		vci-supply = <&s_ldo8_reg>;
		vddi-supply = <&s_bucka_reg>;
	};
};
