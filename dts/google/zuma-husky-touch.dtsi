// SPDX-License-Identifier: GPL-2.0-only
/*
 * Google device tree source
 *
 * Copyright 2022 Google Inc.
 *
 */

#include "../google-dts-base/zuma-fts-touch.dtsi"

&spi_20 {
	status = "okay";
	dma-mode;
	dmas = <&pdma1 18 &pdma1 19>;
	swap-mode = <1>;
};

&spitouch {
	st,dchip_id = /bits/ 8 <0x36 0x40>;
	st,max-coords = <1343 2991>;
	st,panel_map = <&google_hk3 0>;

	goog,vrr-enabled;
	goog,vrr-display-rate = /bits/ 32 <60 120>;
	goog,vrr-touch-rate = /bits/ 32 <120 240>;
	goog,vrr-up-delay = <0>;
	goog,vrr-down-delay = <2>;
};

&m_ldo25_reg {
	regulator-min-microvolt = <1800000>;
	regulator-max-microvolt = <1800000>;
	/delete-property/ regulator-always-on;
};

&m_ldo4_reg {
	regulator-min-microvolt = <3300000>;
	regulator-max-microvolt = <3300000>;
	/delete-property/ regulator-always-on;
};
