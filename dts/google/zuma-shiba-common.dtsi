// SPDX-License-Identifier: GPL-2.0-only
/*
 * Shiba board device tree source
 *
 * Copyright 2022 Google LLC
 */

#include "zuma-board.dtsi"

#include "zuma-shiba-audio.dtsi"
#include "zuma-shiba-battery.dtsi"
#include "zuma-shiba-camera.dtsi"
#include "zuma-shiba-display.dtsi"
#include "zuma-shusky-haptics.dtsi"
#include "zuma-shiba-touch.dtsi"
#include "zuma-shusky-thermal.dtsi"
#include "zuma-shiba-ldaf.dtsi"
#include "zuma-ripcurrent-bluetooth.dtsi"
